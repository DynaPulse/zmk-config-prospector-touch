/*
 * Standalone-scanner additions for the Prospector Touch shield.
 *
 * Provides a mock key source so ZMK has a kscan when the shield is built on its
 * own (no keyboard dongle shield layered underneath). This file lives only in
 * this config repo, so keyboard-dongle builds that bring their own kscan are
 * unaffected.
 */

#include <dt-bindings/zmk/matrix_transform.h>

/ {
    chosen {
        zmk,kscan = &mock_kscan;
        zmk,matrix-transform = &mock_transform;
    };

    mock_kscan: kscan_mock {
        compatible = "zmk,kscan-mock";
        columns = <1>;
        rows = <1>;
        events = <0>;
    };

    mock_transform: keymap_transform {
        compatible = "zmk,matrix-transform";
        columns = <1>;
        rows = <1>;
        map = <RC(0,0)>;
    };
};
